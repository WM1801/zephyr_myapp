## boards/myboard/bluepill_gd32f3/Kconfig.bluepill_gd32f3
```kconfig
# Copyright (c) 2016 Open-RnD Sp. z o.o.
# SPDX-License-Identifier: Apache-2.0

config BOARD_BLUEPILL_GD32F3
	select SOC_STM32F103XB
```

## boards/myboard/bluepill_gd32f3/board.yml
```yaml
board:
  name: bluepill_gd32f3
  full_name: Bluepill GD32F3
  vendor: weact
  socs:
    - name: stm32f103xb
```

## boards/myboard/gd32f3/board.yml
```yaml
board:
  name: gd32f3
  full_name: GD32F3
  vendor: weact
  socs:
    - name: stm32f103xb
```

## boards/myboard/jc4827w543/Kconfig.jc4827w543
```kconfig
# Copyright (c) 2024 Espressif Systems (Shanghai) Co., Ltd.
# SPDX-License-Identifier: Apache-2.0

config BOARD_JC4827W543
	select SOC_ESP32S3_WROOM_N4R8
	select SOC_ESP32S3_PROCPU if BOARD_JC4827W543_PROCPU
	select SOC_ESP32S3_APPCPU if BOARD_JC4827W543_APPCPU
```

## boards/myboard/jc4827w543/board.yml
```yaml
board:
  name: jc4827w543
  full_name: JC4827W543
  vendor: guition
  socs:
    - name: esp32s3
```

## boards/myboard/my429zi/Kconfig.my429zi
```kconfig
# Copyright (c) 2016 Open-RnD Sp. z o.o.
# SPDX-License-Identifier: Apache-2.0

config BOARD_MY429ZI
	select SOC_STM32F429XX
```

## boards/myboard/my429zi/board.yml
```yaml
board:
  name: my429zi
  full_name: my429zi
  vendor: st
  socs:
    - name: stm32f429xx
```

## samples/my_project/sample.yaml
```yaml
sample:
  description: my project for board jc4827w543, the simplest Zephyr
    application
  name: my_project
common:
  min_ram: 2
  min_flash: 16
  tags: introduction
  integration_platforms:
    - native_sim
  harness: console
  harness_config:
    type: one_line
    regex:
      - "my_project! (.*)"
tests:
  sample.basic.my_project:
    tags: introduction
```
