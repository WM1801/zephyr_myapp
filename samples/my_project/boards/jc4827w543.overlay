/ { 
    aliases{
        led0 = &gr_led0; 
    }; 

    leds {
        compatible = "gpio-leds"; 
        gr_led0: led_1{
            gpios = <&gpio0 5 GPIO_ACTIVE_HIGH>; 
            label = "User LD1";
        };
    };
};


